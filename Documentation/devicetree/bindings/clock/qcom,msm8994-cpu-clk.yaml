## Documentation/devicetree/bindings/clock/qcom,msm8994-cpu-clk.yaml
```yaml
# SPDX-License-Identifier: GPL-2.0-only
%YAML 1.2
---
$id: http://devicetree.org/schemas/clock/qcom,msm8994-cpu-clk.yaml#
$schema: http://devicetree.org/meta-schemas/core.yaml#

title: Qualcomm MSM8994 / MSM8992 CPU clock controller

maintainers:
  - Bjorn Andersson <andersson@kernel.org>

description: |
  CPU cluster clocks on MSM8994 and MSM8992. Clock 0 is the A53 cluster
  and clock 1 is the A57 cluster.

  The A53 mux lives in the APCS KPSS global region, which is already the
  mailbox syscon at 0xf900d000. Do not map that window a second time.

properties:
  compatible:
    oneOf:
      - items:
          - const: qcom,msm8992-cpu-clk
          - const: qcom,msm8994-cpu-clk
      - const: qcom,msm8994-cpu-clk

  reg:
    items:
      - description: A53 PLL window (pll0 at +0x00, pll1/PLLA at +0x40)
      - description: A57 PLL window (pll0 at +0x00, pll1/PLLA at +0x40)
      - description: A57 mux (c1_mux)

  reg-names:
    items:
      - const: c0-pll
      - const: c1-pll
      - const: c1-mux

  '#clock-cells':
    const: 1

  clocks:
    minItems: 2
    items:
      - description: XO source
      - description: GPLL0 aux (safe parent)
      - description: BIMC active set (3.10 bimc_a_clk). Optional.

  clock-names:
    minItems: 2
    items:
      - const: xo
      - const: aux
      - const: bimc

  qcom,apcs:
    $ref: /schemas/types.yaml#/definitions/phandle
    description: APCS KPSS global syscon that contains the A53 mux

  power-domains:
    maxItems: 1
    description: |
      PM8994 S2 (VDDMX). 3.10 CPU PLL vdd-dig is pm8994_s2_corner_ao
      (qcom,set = 1, active only), which is MSM8994_VDDMX_AO.

required:
  - compatible
  - reg
  - reg-names
  - '#clock-cells'
  - clocks
  - clock-names
  - qcom,apcs
  - power-domains

additionalProperties: false

examples:
  - |
    #include <dt-bindings/clock/qcom,gcc-msm8994.h>

    clock-controller@f9015000 {
        compatible = "qcom,msm8994-cpu-clk";
        reg = <0xf9015000 0x80>,
              <0xf9016000 0x80>,
              <0xf900f000 0x1000>;
        reg-names = "c0-pll", "c1-pll", "c1-mux";
        qcom,apcs = <&apcs>;
        power-domains = <&rpmpd 4>;
        clocks = <&xo_board>, <&gcc GPLL0>;
        clock-names = "xo", "aux";
        #clock-cells = <1>;
    };
```

## Documentation/devicetree/bindings/pci/qcom,pcie-msm8994.yaml
```yaml
# SPDX-License-Identifier: (GPL-2.0-only OR BSD-2-Clause)
%YAML 1.2
---
$id: http://devicetree.org/schemas/pci/qcom,pcie-msm8994.yaml#
$schema: http://devicetree.org/meta-schemas/core.yaml#

title: Qualcomm MSM8994 PCI Express Root Complex

maintainers:
  - Bjorn Andersson <andersson@kernel.org>
  - Manivannan Sadhasivam <mani@kernel.org>

description:
  MSM8994 (and MSM8992 RC0) DWC host with 3.10 PARF programming
  (SYS_CTRL 0x365E, DBI_BASE 0, AXI halt at 0x178). MSI is a single
  GIC SPI, not the eight MSM8996 MSI SPIs. Do not use 8996 MHI /
  HALT_V2 PARF offsets.

properties:
  compatible:
    const: qcom,pcie-msm8994

  reg:
    maxItems: 4

  reg-names:
    items:
      - const: parf
      - const: dbi
      - const: elbi
      - const: config

  clocks:
    maxItems: 4

  clock-names:
    items:
      - const: aux
      - const: cfg
      - const: bus_master
      - const: bus_slave

  interrupts:
    maxItems: 1

  interrupt-names:
    items:
      - const: msi

  vdda-supply:
    description: Analog PHY supply (PM8994 L28)

  vddpe-3v3-supply:
    description: Endpoint 3.3 V supply

  qcom,scm-dev-id:
    $ref: /schemas/types.yaml#/definitions/uint32
    description:
      TZ device id for restore_sec_cfg. 3.10 uses 11 on pcie0 and
      12 on pcie1.

required:
  - power-domains

allOf:
  - $ref: qcom,pcie-common.yaml#

unevaluatedProperties: false
```

## Documentation/devicetree/bindings/phy/qcom,msm8994-qmp-pcie-phy.yaml
```yaml
# SPDX-License-Identifier: (GPL-2.0 OR BSD-2-Clause)
%YAML 1.2
---
$id: http://devicetree.org/schemas/phy/qcom,msm8994-qmp-pcie-phy.yaml#
$schema: http://devicetree.org/meta-schemas/core.yaml#

title: Qualcomm MSM8994 20nm QMP PCIe PHY

maintainers:
  - Bjorn Andersson <andersson@kernel.org>

description:
  Per-port 20nm QMP PCIe PHY on MSM8994 (and MSM8992 RC0). One 4 KiB
  register block per root complex. Do not use the MSM8996 shared
  wrapper compatible.

properties:
  compatible:
    const: qcom,msm8994-qmp-pcie-phy

  reg:
    maxItems: 1

  clocks:
    maxItems: 3

  clock-names:
    items:
      - const: ref
      - const: ldo
      - const: pipe

  resets:
    maxItems: 1

  reset-names:
    items:
      - const: phy

  vdda-supply:
    description: Analog 1.8 V (3.10 vreg-1.8, PM8994 L12)

  "#clock-cells":
    const: 0

  clock-output-names:
    maxItems: 1

  "#phy-cells":
    const: 0

required:
  - compatible
  - reg
  - clocks
  - clock-names
  - resets
  - reset-names
  - "#clock-cells"
  - clock-output-names
  - "#phy-cells"

additionalProperties: false

examples:
  - |
    #include <dt-bindings/clock/qcom,gcc-msm8994.h>
    #include <dt-bindings/clock/qcom,rpmcc.h>

    phy@fc52e000 {
        compatible = "qcom,msm8994-qmp-pcie-phy";
        reg = <0xfc52e000 0x1000>;

        clocks = <&rpmcc RPM_SMD_LN_BB_CLK>,
                 <&gcc PCIE_1_PHY_LDO>,
                 <&gcc GCC_PCIE_1_PIPE_CLK>;
        clock-names = "ref", "ldo", "pipe";

        resets = <&gcc PCIE_PHY_1_RESET>;
        reset-names = "phy";

        #clock-cells = <0>;
        clock-output-names = "pcie_1_pipe";
        #phy-cells = <0>;
    };
```
